## CMakeLists.txt
```
# CMakeLists for wifi webconfig sample app

# Copyright (c) 2023-2024 NXP
# SPDX-License-Identifier: Apache-2.0

cmake_minimum_required(VERSION 3.20.0)

find_package(Zephyr REQUIRED HINTS $ENV{ZEPHYR_BASE})
find_package(Python REQUIRED COMPONENTS Interpreter)

project(wifi_webconfig)

option(INCLUDE_HTML_CONTENT "Include the HTML content" ON)

target_sources(app PRIVATE src/main.c)

set(gen_dir ${ZEPHYR_BINARY_DIR}/include/generated/)

set(source_file_index src/index.html)
generate_inc_file_for_target(app ${source_file_index} ${gen_dir}/index.html.gz.inc --gzip)

target_link_libraries(app PRIVATE zephyr_interface zephyr)

zephyr_linker_sources(SECTIONS sections-rom.ld)

zephyr_linker_section_ifdef(CONFIG_NET_SAMPLE_HTTP_SERVICE NAME
				http_resource_desc_test_http_service
				KVMA RAM_REGION GROUP RODATA_REGION SUBALIGN 4)
```

## Kconfig
```
# Config options for wifi webconfig sample app

# Copyright (c) 2023-2024 NXP
# SPDX-License-Identifier: Apache-2.0

mainmenu "Wifi webconfig sample application"

config NET_SAMPLE_HTTP_PORT
	int "Port number for http server"
	default 80

source "Kconfig.zephyr"
```

## sample.yaml
```
sample:
  description: Zephyr wifi webconfig
  name: wifi_webconfig
common:
  filter: TOOLCHAIN_HAS_NEWLIB == 1
  harness: net
  min_ram: 256
  tags:
    - http
    - net
    - server
    - wifi
  platform_exclude: native_posix_64
tests:
  sample.net.wifi_webconfig:
    harness: net
    platform_allow:
      - rd_rw612_bga
  sample.net.wifi_webconfig_console:
    harness: console
    harness_config:
      type: multi_line
      regex:
        - "Wi-fi uAP started successfully"
    platform_allow:
      - rd_rw612_bga
```

## prj.conf
```kconfig
# General config
CONFIG_MAIN_STACK_SIZE=8192
CONFIG_SHELL=y
CONFIG_LOG=y
CONFIG_ENTROPY_GENERATOR=y
CONFIG_TEST_RANDOM_GENERATOR=y
CONFIG_INIT_STACKS=y
CONFIG_POSIX_MAX_FDS=32
CONFIG_FDTABLE=y
CONFIG_NET_SOCKETS_POLL_MAX=32
CONFIG_NET_HTTP_SERVER_LOG_LEVEL_INF=y

# Eventfd
CONFIG_EVENTFD=y

# Networking config
CONFIG_NETWORKING=y
CONFIG_NET_IPV4=y
CONFIG_NET_IPV6=y
CONFIG_NET_TCP=y
CONFIG_NET_SOCKETS=y
CONFIG_NET_CONNECTION_MANAGER=y
CONFIG_NET_SHELL=y
CONFIG_NET_LOG=y

# JSON
CONFIG_JSON_LIBRARY=y

# HTTP parser
CONFIG_HTTP_PARSER_URL=y
CONFIG_HTTP_PARSER=y
CONFIG_HTTP_HPACK_TABLE=y
CONFIG_HTTP_SERVER=y

# Network buffers
CONFIG_NET_PKT_RX_COUNT=16
CONFIG_NET_PKT_TX_COUNT=16
CONFIG_NET_BUF_RX_COUNT=128
CONFIG_NET_BUF_TX_COUNT=128
CONFIG_NET_CONTEXT_NET_PKT_POOL=y

# IP address options
CONFIG_NET_IF_UNICAST_IPV6_ADDR_COUNT=3
CONFIG_NET_IF_MCAST_IPV6_ADDR_COUNT=4
CONFIG_NET_MAX_CONTEXTS=32
CONFIG_NET_MAX_CONN=32

# Network address config
CONFIG_NET_CONFIG_SETTINGS=n
CONFIG_NET_CONFIG_NEED_IPV4=y
CONFIG_NET_CONFIG_NEED_IPV6=y
# CONFIG_NET_CONFIG_MY_IPV4_ADDR="192.168.0.222"
# CONFIG_NET_CONFIG_PEER_IPV4_ADDR="192.168.0.1"
# CONFIG_NET_CONFIG_MY_IPV4_GW="192.168.0.1"
# CONFIG_NET_CONFIG_MY_IPV6_ADDR="2001:db8::1"
# CONFIG_NET_CONFIG_PEER_IPV6_ADDR="2001:db8::2"

# TLS configuration
CONFIG_MBEDTLS=y
CONFIG_MBEDTLS_BUILTIN=y
CONFIG_MBEDTLS_ENABLE_HEAP=y
CONFIG_MBEDTLS_HEAP_SIZE=60000
CONFIG_MBEDTLS_SSL_MAX_CONTENT_LEN=2048
CONFIG_NET_SOCKETS_SOCKOPT_TLS=y
CONFIG_NET_SOCKETS_TLS_MAX_CONTEXTS=6
CONFIG_TLS_CREDENTIALS=y
CONFIG_TLS_MAX_CREDENTIALS_NUMBER=5

# Networking tweaks
# Required to handle large number of consecutive connections,
# e.g. when testing with ApacheBench.
CONFIG_NET_TCP_TIME_WAIT_DELAY=0
```

## boards/rd_rw612_bga.conf
```kconfig
CONFIG_WIFI=y
CONFIG_WIFI_NXP=y
# CONFIG_NET_L2_WIFI_SHELL=y
CONFIG_NET_DHCPV4=y
CONFIG_RW610=y

#
# C Library
#
CONFIG_NEWLIB_LIBC=y
CONFIG_CBPRINTF_FP_SUPPORT=y

# log
CONFIG_WIFI_LOG_LEVEL_WRN=y
CONFIG_THREAD_LOCAL_STORAGE=y
CONFIG_ASSERT=y
CONFIG_ASSERT_LEVEL=2
CONFIG_LOG_MODE_IMMEDIATE=y
CONFIG_LOG_PRINTK=n

# os
CONFIG_EVENTS=y
CONFIG_SYS_HEAP_AUTO=y
CONFIG_HEAP_MEM_POOL_SIZE=122880
CONFIG_SCHED_MULTIQ=y
CONFIG_POSIX_MAX_FDS=8

# shell
CONFIG_SHELL_ARGC_MAX=48

# net
CONFIG_ETH_MCUX=n
CONFIG_NET_BUF_LOG=y
CONFIG_NET_PKT_RX_COUNT=60
CONFIG_NET_PKT_TX_COUNT=40
CONFIG_NET_BUF_RX_COUNT=60
CONFIG_NET_BUF_TX_COUNT=80
CONFIG_NET_BUF_DATA_SIZE=1744
CONFIG_NET_TC_TX_COUNT=1
CONFIG_NET_TC_RX_COUNT=1
CONFIG_NET_MGMT_EVENT_QUEUE_SIZE=20
CONFIG_NET_IF_MAX_IPV4_COUNT=2
CONFIG_NET_IF_MAX_IPV6_COUNT=2
CONFIG_DNS_RESOLVER=y
CONFIG_DNS_RESOLVER_MAX_SERVERS=2
CONFIG_NET_SOCKETS_POLL_MAX=8
CONFIG_NET_IPV4_FRAGMENT_MAX_PKT=7
CONFIG_NET_IPV6_FRAGMENT_MAX_PKT=7

# net threads priority
CONFIG_NET_TC_THREAD_PRIO_CUSTOM=y
CONFIG_NET_TC_THREAD_PREEMPTIVE=y
CONFIG_NET_TCP_WORK_QUEUE_THREAD_PRIO=-16
CONFIG_NET_TC_TX_THREAD_BASE_PRIO=3
CONFIG_NET_TC_RX_THREAD_BASE_PRIO=3

# wpa_supplicant
CONFIG_WPA_SUPP=y
CONFIG_WPA_SUPP_AP=y
CONFIG_WPA_SUPP_CRYPTO=y
CONFIG_WPA_SUPP_WPS=y
CONFIG_WPA_SUPP_WPA3=y
CONFIG_WPA_SUPP_CRYPTO_ENTERPRISE=y
CONFIG_WPA_SUPP_CRYPTO_AP_ENTERPRISE=y
CONFIG_WPA_SUPP_CRYPTO_MBEDTLS_PSA=y
CONFIG_WPA_SUPP_LOG_LEVEL_INF=y

# Enable mbedtls
CONFIG_MBEDTLS=y
CONFIG_MBEDTLS_BUILTIN=y
CONFIG_MBEDTLS_USER_CONFIG_ENABLE=y
CONFIG_MBEDTLS_USER_CONFIG_FILE="wpa_supp_els_pkc_mbedtls_config.h"
CONFIG_KSDK_MBEDTLS=n

# Include els_pkc in build
CONFIG_MCUX_ELS_PKC=y
CONFIG_MCUX_PSA_CRYPTO_DRIVER_ELS_PKC=y
CONFIG_ENTROPY_GENERATOR=y
CONFIG_MBEDTLS_PSA_CRYPTO_C=y
CONFIG_MBEDTLS_ENTROPY_ENABLED=y
CONFIG_MBEDTLS_ZEPHYR_ENTROPY=y
CONFIG_MBEDTLS_SSL_MAX_CONTENT_LEN=8192

# stack size
CONFIG_SHELL_STACK_SIZE=5120
CONFIG_SYSTEM_WORKQUEUE_STACK_SIZE=2048
CONFIG_NET_MGMT_EVENT_STACK_SIZE=2048
CONFIG_WPA_SUPP_THREAD_STACK_SIZE=12288

# optimization level
# refer to Kconfig.zephyr for Optimizations Level
CONFIG_SPEED_OPTIMIZATIONS=y
#CONFIG_SIZE_OPTIMIZATIONS=y
#CONFIG_DEBUG_OPTIMIZATIONS=y
#CONFIG_NO_OPTIMIZATIONS=y

# debug & stats
CONFIG_SYS_HEAP_VALIDATE=y
CONFIG_SYS_HEAP_RUNTIME_STATS=y
#CONFIG_NET_PKT_TXTIME_STATS=y
#CONFIG_NET_PKT_TXTIME_STATS_DETAIL=y
#CONFIG_NET_STATISTICS_WIFI=y
#CONFIG_NET_STATISTICS_USER_API=y
#CONFIG_NET_STATISTICS_PERIODIC_OUTPUT=y
#CONFIG_NET_BUF_POOL_USAGE=y
#CONFIG_NET_DEBUG_NET_PKT_ALLOC=y

# stack size for -O0
#CONFIG_SHELL_STACK_SIZE=8192
#CONFIG_NET_TCP_WORKQ_STACK_SIZE=4096
#CONFIG_NET_TX_STACK_SIZE=4096
#CONFIG_NET_RX_STACK_SIZE=4096
#CONFIG_SYSTEM_WORKQUEUE_STACK_SIZE=4096
#CONFIG_ZPERF_WORK_Q_STACK_SIZE=4096
#CONFIG_MAIN_STACK_SIZE=2048
#CONFIG_WPA_SUPP_THREAD_STACK_SIZE=16384
#CONFIG_IDLE_STACK_SIZE=2048

# comment out for -O0
CONFIG_CODE_DATA_RELOCATION_SRAM=y

# power management
CONFIG_PM=y
CONFIG_PM_DEVICE=y
CONFIG_IDLE_STACK_SIZE=1024
CONFIG_PM_LOG_LEVEL_OFF=y
```

## src/main.c
```c
/**
 * Copyright 2023-2024 NXP
 * SPDX-License-Identifier: Apache-2.0
 *
 * @file main.c
 * Wifi webconfig sample application
 */

#include <stdio.h>
#include <stdbool.h>

#include <zephyr/kernel.h>
#include <zephyr/net/tls_credentials.h>
#include <zephyr/net/http/server.h>
#include <zephyr/net/http/service.h>
#include <zephyr/net/http/status.h>
#include <zephyr/net/net_ip.h>
#include <zephyr/net/socket.h>

#include <zephyr/net/wifi_mgmt.h>

#include <zephyr/logging/log.h>
LOG_MODULE_REGISTER(net_webconfig_sample, LOG_LEVEL_DBG);

/* JSON returned for /status route */
#define ROUTE_STATUS_JSON "{\"info\":{" \
	"\"name\":\"" CONFIG_BOARD "\"," \
	"\"ip\":\"%s\"," \
	"\"status\":\"%s\"" \
	"}}"

#define ROUTE_CONNECT_JSON "{" \
"\"status\":\"%s\"," \
"\"ssid\":\"%s\"," \
"\"new_ip\":\"%s\"" \
"}"

#define UAP_SSID "webconfig_access_point"
#define UAP_PSK "ap012345"

K_THREAD_STACK_DEFINE(webconfig_stack, 4096);

K_EVENT_DEFINE(webconfig_event);

struct app_data
{
	/* Saved credentials for current network. Empty strings if not connected.
	 * Pass is empty for open security network */
    char ssid[WIFI_SSID_MAX_LEN];
    char pass[WIFI_PSK_MAX_LEN];
	/* When connected to a network, active_ip will be station's IP address.
	 * otherwise it will be set to the default uAP address */
	char active_ip[INET_ADDRSTRLEN];
	/* True if connected to a network */
    bool connected;
	/* Contains the most recent wifi scan data in JSON format */
	char scan_json[2048];

	struct k_work_q webconfig_work_q;
	struct k_work_delayable disconnect_work;
	struct k_work_delayable start_ap_work;
	struct net_mgmt_event_callback webconfig_event_cb;
};
static struct app_data app;

/* HTTP port to listen on */
static uint16_t http_port = CONFIG_NET_SAMPLE_HTTP_PORT;

/* Webpage data to serve to the user's browser */
static uint8_t index_html_gz[] = {
#include "index.html.gz.inc"
};
static uint8_t recv_buffer[2048];

enum route_state {
	ROUTE_SENDING,
	ROUTE_IDLE
};

/* Function for GET request query string parameter parser
 */
struct param {
	char name[32];
	char value[64];
};
static int next_param(const uint8_t *buffer, size_t len, struct param *p) {
	int eq_index = -1;
	int end_index = -1;
	int i = 0;
	if (len == 0) {
		return 0;
	}
	while (i < len && buffer[i] != '&') {
		if (buffer[i] == '=') {
			eq_index = i;
		}
		i += 1;
	}
	end_index = i;
	int name_len = eq_index == -1 ? end_index : eq_index;
	int value_len = eq_index == -1 ? 0 : end_index - eq_index - 1;
	strncpy(p->name, buffer, name_len);
	p->name[name_len] = '\0';
	strncpy(p->value, buffer+eq_index+1, value_len);
	p->value[value_len] = '\0';

	return i + (i==len ? 0 : 1); // Number of chars processed
}

/* GET /status
 * returns JSON
*/
static int route_status(struct http_client_ctx *client, uint8_t *buffer, size_t len, void *user_data)
{
	static enum route_state state = ROUTE_IDLE;
	int ret = 0;
	if (state == ROUTE_IDLE) {
		state = ROUTE_SENDING;

		if (strlen(app.active_ip) == 0) {
			/* No active IP set, get uAP address */
			int wifi_uap_index = net_if_get_by_name("ua");
			struct net_if *_iface = net_if_get_by_index(wifi_uap_index);
			struct in_addr *addr = net_if_ipv4_get_global_addr(_iface, NET_ADDR_PREFERRED);
			inet_ntop(AF_INET, addr, app.active_ip, sizeof(app.active_ip));
		}
		ret = snprintk(recv_buffer, sizeof(recv_buffer), ROUTE_STATUS_JSON,
			app.active_ip,
		    app.connected ? "client" : "ap");
	}
	else if (state == ROUTE_SENDING){
		LOG_DBG("Finished route_status");
		state = ROUTE_IDLE;
		ret = 0;
	}

	/* Note: ret indicates how many bytes from buffer will be actually sent to client */
	return ret;
}

/* GET /scan
 * returns JSON
*/
static int route_scan(struct http_client_ctx *client, uint8_t *buffer, size_t len, void *user_data)
{
	static enum route_state state = ROUTE_IDLE;
	int ret = 0;
	if (state == ROUTE_IDLE) {
		state = ROUTE_SENDING;
		struct net_if *iface = net_if_get_first_wifi();
		struct wifi_scan_params params = { 0 };
		int failure = 0;

		if (net_mgmt(NET_REQUEST_WIFI_SCAN, iface, &params, sizeof(params))) {
			LOG_ERR("Scan request failed");
			failure = 1;
		}
		else {
			uint32_t events = k_event_wait(&webconfig_event, 0x001, true, K_FOREVER);
			if (events == 0) {
				failure = 1;
			}
		}

		if (failure) {
			ret = snprintk(recv_buffer, sizeof(recv_buffer), "{\"networks\":[]}");
		}
		else {
			ret = snprintk(recv_buffer, sizeof(recv_buffer), "{\"networks\":[%s]}", app.scan_json);
		}
	}
	else if (state == ROUTE_SENDING){
		state = ROUTE_IDLE;
		LOG_DBG("Finished route_scan");
		ret = 0;
	}

	return ret;
}

/* GET /connect?ssid=<ssid>&pass=<pass>
 * returns JSON
*/
static int route_connect(struct http_client_ctx *client, uint8_t *buffer, size_t len, void *user_data)
{
	/* FIXME: this route needs to be changed to POST request */
	static enum route_state state = ROUTE_IDLE;
	int ret = 0;

	if (state == ROUTE_IDLE) {
		state = ROUTE_SENDING;
		struct wifi_connect_req_params params = { 0 };
		app.ssid[0] = '\0';
		app.pass[0] = '\0';
		int processed = 1; // skip 0th byte as it is the '?' separator
		int bytes_read;
		struct param p;
		while ((bytes_read = next_param(buffer+processed, len-processed, &p))) {
			processed += bytes_read;
			if (strcmp(p.name, "ssid") == 0) {
				LOG_DBG("Got ssid=%s", p.value);
				strcpy(app.ssid, p.value);
			}
			else if (strcmp(p.name, "pass") == 0) {
				LOG_DBG("Got pass=%s", p.value);
				strcpy(app.pass, p.value);
			}
			else {
				LOG_DBG("Unknown GET param %s=%s", p.name, p.value);
			}
		}
		params.ssid = app.ssid;
		params.psk = app.pass;
		params.ssid_length = strlen(app.ssid);
		params.psk_length = strlen(app.pass);
		if (params.psk_length > 0) {
			params.security = WIFI_SECURITY_TYPE_PSK;
		}
		struct net_if *iface = net_if_get_first_wifi();
		ret = net_mgmt(NET_REQUEST_WIFI_CONNECT, iface, &params, sizeof(struct wifi_connect_req_params));
		if (ret) {
			LOG_ERR("wifi connect request failed");
			ret = snprintk(recv_buffer, sizeof(recv_buffer), ROUTE_CONNECT_JSON, "failure", app.ssid, "");
		}
		else {
			/* Wait for connect to complete. This wait is needed because we need station's IP address, which
			 * gets sent back to the user. */
			k_event_wait(&webconfig_event, 0x002, true, K_FOREVER);
			ret = snprintk(recv_buffer, sizeof(recv_buffer), ROUTE_CONNECT_JSON, "success", app.ssid, app.active_ip);
			app.connected = true;
		}
	}
	else if (state == ROUTE_SENDING){
		LOG_DBG("Finished route_connect");
		state = ROUTE_IDLE;
	}

	return ret;
}

/* GET /reset
 * returns JSON
*/
static int route_reset(struct http_client_ctx *client, uint8_t *buffer, size_t len, void *user_data)
{
	static enum route_state state = ROUTE_IDLE;
	int ret = 0;

	if (state == ROUTE_IDLE) {
		state = ROUTE_SENDING;
		ret = snprintk(recv_buffer, sizeof(recv_buffer), ROUTE_CONNECT_JSON,
			"success", UAP_SSID, "192.168.10.1");
	}
	else if (state == ROUTE_SENDING){
		LOG_DBG("Finished route_reset");
		/* The route is done sending data, schedule wifi disconnect */
		k_work_schedule_for_queue(&app.webconfig_work_q, &app.disconnect_work, K_MSEC(1000));
		state = ROUTE_IDLE;
	}

	return ret;
}

/* HTTP resource detail definitions */
struct http_resource_detail_static index_resource_detail = {
	.common = {
		.type = HTTP_RESOURCE_TYPE_STATIC,
		.bitmask_of_supported_http_methods = BIT(HTTP_GET),
	},
	.static_data = index_html_gz,
	.static_data_len = sizeof(index_html_gz),
};

struct http_resource_detail_dynamic status_resource_detail = {
	.common = {
		.type = HTTP_RESOURCE_TYPE_DYNAMIC,
		.bitmask_of_supported_http_methods = BIT(HTTP_GET),
	},
	.cb = route_status,
	.data_buffer = recv_buffer, .data_buffer_len = sizeof(recv_buffer), .user_data = NULL,
};

struct http_resource_detail_dynamic scan_resource_detail = {
	.common = {
		.type = HTTP_RESOURCE_TYPE_DYNAMIC,
		.bitmask_of_supported_http_methods = BIT(HTTP_GET),
	},
	.cb = route_scan,
	.data_buffer = recv_buffer, .data_buffer_len = sizeof(recv_buffer), .user_data = NULL,
};

struct http_resource_detail_dynamic connect_resource_detail = {
	.common = {
		.type = HTTP_RESOURCE_TYPE_DYNAMIC,
		.bitmask_of_supported_http_methods = BIT(HTTP_GET),
	},
	.cb = route_connect,
	.data_buffer = recv_buffer, .data_buffer_len = sizeof(recv_buffer), .user_data = NULL,
};

struct http_resource_detail_dynamic reset_resource_detail = {
	.common = {
		.type = HTTP_RESOURCE_TYPE_DYNAMIC,
		.bitmask_of_supported_http_methods = BIT(HTTP_GET),
	},
	.cb = route_reset,
	.data_buffer = recv_buffer, .data_buffer_len = sizeof(recv_buffer), .user_data = NULL,
};

HTTP_SERVICE_DEFINE(test_http_service, "0.0.0.0", &http_port, 1, 10, NULL);

HTTP_RESOURCE_DEFINE(index_resource, test_http_service, "/", &index_resource_detail);
HTTP_RESOURCE_DEFINE(status_resource, test_http_service, "/status", &status_resource_detail);
HTTP_RESOURCE_DEFINE(scan_resource, test_http_service, "/scan", &scan_resource_detail);
HTTP_RESOURCE_DEFINE(connect_resource, test_http_service, "/connect", &connect_resource_detail);
HTTP_RESOURCE_DEFINE(reset_resource, test_http_service, "/reset", &reset_resource_detail);

/**
 * @brief Used to handle wifi events by this web server application.
 */
static void webconfig_event_handler(struct net_mgmt_event_callback *cb,
				    uint32_t mgmt_event, struct net_if *iface)
{
/* Scan entry JSON template */
#define ROUTE_SCAN_JSON \
"{" \
	"\"ssid\":\"%s\"," \
	"\"bssid\":\"%02X:%02X:%02X:%02X:%02X:%02X\"," \
	"\"channel\":\"%d\"," \
	"\"signal\":\"%d\"," \
	"\"security\":\"%s\"" \
"}"

	static int scan_n = 0;
	struct net_if *_iface;
	struct in_addr *addr;

	switch (mgmt_event) {
	case NET_EVENT_WIFI_SCAN_RESULT:
		const struct wifi_scan_result *e = (const struct wifi_scan_result *)cb->info;
		char entry_json[128];
		if (scan_n == 0) {
			app.scan_json[0] = '\0';
		}
		snprintk(entry_json, sizeof(entry_json), ROUTE_SCAN_JSON ",",
			e->ssid,
			e->mac[0], e->mac[1], e->mac[2], e->mac[3], e->mac[4], e->mac[5],
			e->channel,
			e->rssi,
			wifi_security_txt(e->security)
		);
		strcat(app.scan_json, entry_json);
		scan_n += 1;
		break;
	case NET_EVENT_WIFI_SCAN_DONE:
		scan_n = 0;
		int scan_json_len = strlen(app.scan_json);
		if (scan_json_len > 0) {
			app.scan_json[scan_json_len - 1] = '\0'; // To remove last ',' from JSON
		}
		k_event_set(&webconfig_event, 0x001);
		break;
	case NET_EVENT_WIFI_CONNECT_RESULT:
		app.connected = true;
		_iface = net_if_get_first_wifi();
		addr = net_if_ipv4_get_global_addr(_iface, NET_ADDR_PREFERRED);
		inet_ntop(AF_INET, addr, app.active_ip, sizeof(app.active_ip));
		LOG_WRN("The device has connected to \"%s\" and is reachable at %s", app.ssid, app.active_ip);
		k_event_set(&webconfig_event, 0x002);
		break;
	case NET_EVENT_WIFI_DISCONNECT_RESULT:
		app.connected = false;
		app.ssid[0] = '\0';
		app.pass[0] = '\0';
		int wifi_uap_index = net_if_get_by_name("ua");
		_iface = net_if_get_by_index(wifi_uap_index);
		addr = net_if_ipv4_get_global_addr(_iface, NET_ADDR_PREFERRED);
		inet_ntop(AF_INET, addr, app.active_ip, sizeof(app.active_ip));
		LOG_WRN("The device has disconnected from the network. Connect back" \
		" to this device's wifi network \"%s\" and browse to %s", UAP_SSID, app.active_ip);
		k_event_set(&webconfig_event, 0x002);
		break;
	default:
		break;
	}
}

static void defer_disconnect(struct k_work *item) {
	int ret;
	struct net_if *iface = net_if_get_first_wifi();
	ret = net_mgmt(NET_REQUEST_WIFI_DISCONNECT, iface, NULL, 0);
	if (ret) {
		LOG_ERR("wifi disconnect request failed");
	}
}

static void defer_start_ap(struct k_work *item) {
	int ret;
	int wifi_uap_index = net_if_get_by_name("ua");
	struct net_if *iface = net_if_get_by_index(wifi_uap_index);
	LOG_DBG("Starting uAP on iface: %d (%p)", wifi_uap_index, iface);
	if (iface == NULL) {
		LOG_ERR("\"ua\" wifi network interface not found. Please make sure" \
			"the wifi driver is initializing this netif before app starts.");
	}
	else {
		struct wifi_connect_req_params params = {
			.ssid = UAP_SSID,
			.ssid_length = sizeof(UAP_SSID),
			.psk = UAP_PSK,
			.psk_length = sizeof(UAP_PSK),
			.security = WIFI_SECURITY_TYPE_PSK,
		};
		ret = net_mgmt(NET_REQUEST_WIFI_AP_ENABLE, iface, &params, sizeof(params));
		if (ret) {
			LOG_ERR("Wi-fi uAP request failed");
		}
		else {
			LOG_INF("Wi-fi uAP started successfully");
		}
	}
	return;
}

int main(void) {
	/* Setup wifi callbacks for this application */
	net_mgmt_init_event_callback(&app.webconfig_event_cb,
				     webconfig_event_handler,
				     ( NET_EVENT_WIFI_SCAN_RESULT
					 | NET_EVENT_WIFI_SCAN_DONE
					 | NET_EVENT_WIFI_CONNECT_RESULT
					 | NET_EVENT_WIFI_DISCONNECT_RESULT));
	net_mgmt_add_event_callback(&app.webconfig_event_cb);

	k_work_queue_init(&app.webconfig_work_q);
	k_work_queue_start(&app.webconfig_work_q, webconfig_stack,
					K_THREAD_STACK_SIZEOF(webconfig_stack), 1,
					NULL);
	k_work_init_delayable(&app.disconnect_work, defer_disconnect);
	k_work_init_delayable(&app.start_ap_work, defer_start_ap);

	/* Schedule uAP start */
	k_work_schedule_for_queue(&app.webconfig_work_q, &app.start_ap_work, K_MSEC(2000));

	/* Init HTTP server */
	struct http_server_ctx ctx;
	int ret;
	ret = http_server_init(&ctx);
	if (ret < 0) {
		LOG_ERR("Failed to initialize HTTP2 server");
		return ret;
	}

	/* Start HTTP server (endless loop until server is stopped) */
	ret = http_server_start(&ctx);

	return ret;
}
```
